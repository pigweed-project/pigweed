## pw_assert_zephyr/Kconfig
```kconfig
# Copyright 2021 The Pigweed Authors
#
# Licensed under the Apache License, Version 2.0 (the "License"); you may not
# use this file except in compliance with the License. You may obtain a copy of
# the License at
#
#     https://www.apache.org/licenses/LICENSE-2.0
#
# Unless required by applicable law or agreed to in writing, software
# distributed under the License is distributed on an "AS IS" BASIS, WITHOUT
# WARRANTIES OR CONDITIONS OF ANY KIND, either express or implied. See the
# License for the specific language governing permissions and limitations under
# the License.

menu "pw_assert"

config PIGWEED_ASSERT_PIGWEED_OVERRIDES
    bool
    select ASSERT_CUSTOM_HEADER
    help
      Map all the Zephyr assert macros to use Pigweed's PW_ASSERT* macros, so
      that all asserts are consumed by the same assert backend, provided by the
      user. The user must also provide the assert backend header indirection.

choice PIGWEED_ASSERT_BACKEND
    prompt "pw_assert.assert / pw_assert.check backend used"
    default PIGWEED_ASSERT_ZEPHYR
    help
      What PW_ASSERT()/PW_CHECK()/PW_CRASH() do when they fire. Defaults to
      Zephyr's assert. Choose "none" to provide your own backend.

config PIGWEED_ASSERT_ZEPHYR
    bool "Link pw_assert_zephyr library"
    select PIGWEED_PREPROCESSOR
    help
      Routes Pigweed's own PW_ASSERT()/PW_CHECK()/PW_CRASH() into Zephyr's
      assert subsystem: a failure calls, in order, ``__ASSERT_LOC()``, then
      (if there's a message) ``__ASSERT_MSG_INFO()``, then
      ``__ASSERT_POST_ACTION()``. This is one-directional -- only Pigweed's
      own assert macros are affected. Zephyr's own native ``__ASSERT()``
      call sites elsewhere in the kernel and subsystems are untouched and
      keep behaving however Zephyr's own CONFIG_ASSERT/CONFIG_ASSERT_LEVEL
      configure them. See :ref:`module-pw_assert` for module details.

config PIGWEED_ASSERT_TOKENIZED
    bool "Maps all Zephyr assert macros to use pw_assert_tokenized as the backend"
    select PIGWEED_ASSERT_PIGWEED_OVERRIDES
    select PIGWEED_PREPROCESSOR
    select PIGWEED_TOKENIZER
    help
      Does two things:

      1. Redirects Zephyr's own native assert macros (the ones Zephyr's
         kernel and subsystems call internally) to go through Pigweed's
         PW_ASSERT()/PW_CHECK() instead of Zephyr's own assert subsystem
         (this is what PIGWEED_ASSERT_PIGWEED_OVERRIDES, selected above,
         does via ASSERT_CUSTOM_HEADER).
      2. Sets :ref:`module-pw_assert_tokenized` as the backend for
         PW_ASSERT()/PW_CHECK()/PW_CRASH() themselves (Pigweed's own calls,
         and -- because of (1) -- what used to be Zephyr's own asserts
         too), so every one of them gets tokenized and forwarded to the log
         system instead of calling into Zephyr's assert subsystem.

      The tokenizer handler should check for ``LOG_LEVEL_FATAL`` and
      properly divert to a crash handler. Make sure an appropriate
      PIGWEED_LOG_TOKENIZED* configuration is set.

config PIGWEED_ASSERT_NONE
    bool "Provide your own pw_assert.assert/pw_assert.check backend"
    help
      Pigweed's Zephyr backend is not linked in. Wire up your own via
      pw_set_backend() or an equivalent mechanism.

endchoice

endmenu
```

## pw_log_zephyr/Kconfig
```kconfig
# Copyright 2021 The Pigweed Authors
#
# Licensed under the Apache License, Version 2.0 (the "License"); you may not
# use this file except in compliance with the License. You may obtain a copy of
# the License at
#
#     https://www.apache.org/licenses/LICENSE-2.0
#
# Unless required by applicable law or agreed to in writing, software
# distributed under the License is distributed on an "AS IS" BASIS, WITHOUT
# WARRANTIES OR CONDITIONS OF ANY KIND, either express or implied. See the
# License for the specific language governing permissions and limitations under
# the License.

menu "pw_log"

config PIGWEED_LOG_PIGWEED_OVERRIDES
    bool
    select LOG_CUSTOM_HEADER
    imply SHELL_CUSTOM_HEADER
    help
      Map all the Zephyr log macros to use Pigweed's PW_LOG* macros, so that
      all logs are consumed by the same log backend, provided by the user. The
      user must also provide the log backend header indirection.
      Use PIGWEED_LOG_PIGWEED if PIGWEED_LOG is enabled.

choice PIGWEED_LOG
    prompt "Logging backend used"
    default PIGWEED_LOG_ZEPHYR if CPP
    default PIGWEED_LOG_NONE
    help
      The type of Zephyr pw_log backend to use. See :ref:`module-pw_log` for
      module details

config PIGWEED_LOG_NONE
    bool "Do not use Pigweed logging"
    help
      PW_LOG_ statements will not work.

config PIGWEED_LOG_ZEPHYR
    bool "Maps all PW_LOG_* macros to Zephyr log macros"
    select PIGWEED_PREPROCESSOR
    help
      Once the Pigweed logging is enabled, all Pigweed logs via PW_LOG_*() will
      be routed to the Zephyr logging system. This means that:
      - :c:macro:`PW_LOG_LEVEL_DEBUG` maps to Zephyr's LOG_LEVEL_DBG
      - :c:macro:`PW_LOG_LEVEL_INFO` maps to Zephyr's LOG_LEVEL_INF
      - :c:macro:`PW_LOG_LEVEL_WARN` maps to Zephyr's LOG_LEVEL_WRN
      - :c:macro:`PW_LOG_LEVEL_ERROR` maps to Zephyr's LOG_LEVEL_ERR
      - :c:macro:`PW_LOG_LEVEL_CRITICAL` maps to Zephyr's LOG_LEVEL_ERR
      - :c:macro:`PW_LOG_LEVEL_FATAL` maps to Zephyr's LOG_LEVEL_ERR

config PIGWEED_LOG_PIGWEED
    bool "Maps all Zephyr log macros to PW_LOG_* macros unifying their handling"
    select PIGWEED_LOG_PIGWEED_OVERRIDES
    help
      Same as PIGWEED_LOG_PIGWEED_OVERRIDES.

config PIGWEED_LOG_STRING
    bool "All logs are strings and implement your own pw_log_string_HandleMessageVaList"
    select PIGWEED_LOG_PIGWEED_OVERRIDES
    help
      Map all the Zephyr log macros to use Pigweed's then use the
      :ref:`module-pw_log_string` target as to receive the logs as strings.
      Users must provide pw_log_string_HandleMessageVaList

menuconfig PIGWEED_LOG_TOKENIZED
    bool "Maps all Zephyr log macros to pw_tokenizer"
    select PIGWEED_LOG_PIGWEED_OVERRIDES
    select PIGWEED_PREPROCESSOR
    select PIGWEED_TOKENIZER
    help
      Map all the Zephyr log macros to use Pigweed's then use the
      :ref:`module-pw_log_tokenized` target as the logging backend in order to
      automatically tokenize all the logging strings. This means that Pigweed
      will also tokenize all of Zephyr's logging statements. Also requires
      pw_sync.interrupt_spin_lock, pw_sys_io, and a
      pw_log_tokenized.handler backend (see PIGWEED_LOG_TOKENIZED_HANDLER_BACKEND
      below) -- CMake will fail the build naming any of these that aren't
      configured.

config PIGWEED_LOG_TOKENIZED_LIB
    bool "Tokenize logging and implement your own pw_log_tokenized_HandleLog"
    select PIGWEED_LOG_PIGWEED_OVERRIDES
    select PIGWEED_TOKENIZER
    help
      Same as PIGWEED_LOG_TOKENIZED but you'll need to implement
      pw_log_tokenized_HandleLog. This gives you flexiblity to access handlers
      outside of pigweed.

config PIGWEED_LOG_NONE
    bool "Do not use pigweed logging"
    help
      Pigweed log macros will not work unless the application manually
      configures the logging backend.

menuconfig PIGWEED_LOG_TOKENIZED_RPC
    bool "Enables RPC tokenized logging"
    select PIGWEED_SYSTEM_LOG_BACKEND
    select PIGWEED_TOKENIZER
    select LOG_CUSTOM_HEADER
    select SHELL_CUSTOM_HEADER
    depends on CONSOLE_GETCHAR
    help
      Enable tokenized logging over RPC by using the system log backend.
      Also requires pw_sync.interrupt_spin_lock, pw_sync.thread_notification,
      pw_sync.timed_thread_notification, pw_system.rpc_server,
      pw_system.target_hooks, pw_thread.thread, pw_thread.thread_iteration,
      and a pw_log_tokenized.handler backend -- CMake will fail the build
      naming any of these that aren't configured.

endchoice

choice PIGWEED_LOG_TOKENIZED_HANDLER_BACKEND
    prompt "pw_log_tokenized.handler backend used"
    default PIGWEED_LOG_TOKENIZED_HANDLER_NONE if PIGWEED_LOG_TOKENIZED_LIB
    default PIGWEED_LOG_TOKENIZED_HANDLER_SYSTEM if PIGWEED_SYSTEM_LOG_BACKEND
    default PIGWEED_LOG_TOKENIZED_HANDLER_ZEPHYR
    help
      Where tokenized log bytes go. Defaults to Zephyr's log subsystem, to
      pw_system's log backend with PIGWEED_SYSTEM_LOG_BACKEND (which
      PIGWEED_LOG_TOKENIZED_RPC selects), or to none with
      PIGWEED_LOG_TOKENIZED_LIB, where the application provides the handler.

config PIGWEED_LOG_TOKENIZED_HANDLER_ZEPHYR
    bool "Route tokenized logs to Zephyr's own log subsystem"

config PIGWEED_LOG_TOKENIZED_HANDLER_SYSTEM
    bool "Route tokenized logs to pw_system's log backend"

config PIGWEED_LOG_TOKENIZED_HANDLER_NONE
    bool "Provide your own pw_log_tokenized.handler backend"
    help
      Pigweed's handler is not linked in. Wire up your own via
      pw_set_backend() or an equivalent mechanism.

endchoice

if !PIGWEED_LOG_NONE

choice "PIGWEED_LOG_LEVEL_CHOICE"
	prompt "Max compiled-in log level for pigweed"
	default PIGWEED_LOG_LEVEL_DEFAULT
	depends on LOG

config PIGWEED_LOG_LEVEL_OFF
	bool "Off"
	help
	  Turn off all Pigweed logging.

config PIGWEED_LOG_LEVEL_ERR
	bool "Error"
	help
	  Only print error level log statements.

config PIGWEED_LOG_LEVEL_WRN
	bool "Warning"
	help
	  Only print warning level log statements and above.

config PIGWEED_LOG_LEVEL_INF
	bool "Info"
	help
	  Only print info level log statements and above.

config PIGWEED_LOG_LEVEL_DBG
	bool "Debug"
	help
	  Print all log statements.

config PIGWEED_LOG_LEVEL_DEFAULT
	bool "Default"
	help
	  Use Zephyr's ``LOG_DEFAULT_LEVEL`` as the log level.

endchoice

config PIGWEED_LOG_LEVEL
	int
	depends on LOG
	default 0 if PIGWEED_LOG_LEVEL_OFF
	default 1 if PIGWEED_LOG_LEVEL_ERR
	default 2 if PIGWEED_LOG_LEVEL_WRN
	default 3 if PIGWEED_LOG_LEVEL_INF
	default 4 if PIGWEED_LOG_LEVEL_DBG
	default LOG_DEFAULT_LEVEL if PIGWEED_LOG_LEVEL_DEFAULT

endif # !PIGWEED_LOG_NONE

if PIGWEED_LOG_TOKENIZED
rsource "Kconfig.tokenized"
endif # PIGWEED_LOG_TOKENIZED

endmenu
```

## pw_sync_zephyr/Kconfig
```kconfig
# Copyright 2021 The Pigweed Authors
#
# Licensed under the Apache License, Version 2.0 (the "License"); you may not
# use this file except in compliance with the License. You may obtain a copy of
# the License at
#
#     https://www.apache.org/licenses/LICENSE-2.0
#
# Unless required by applicable law or agreed to in writing, software
# distributed under the License is distributed on an "AS IS" BASIS, WITHOUT
# WARRANTIES OR CONDITIONS OF ANY KIND, either express or implied. See the
# License for the specific language governing permissions and limitations under
# the License.

menu "pw_sync"

config PIGWEED_SYNC
    bool
    select PIGWEED_PREPROCESSOR

choice PIGWEED_SYNC_MUTEX_BACKEND
    prompt "pw_sync.mutex backend used"
    default PIGWEED_SYNC_MUTEX
    help
      Defaults to Pigweed's Zephyr backend. Choose "none" to provide
      your own with pw_set_backend().

config PIGWEED_SYNC_MUTEX
    bool "Link pw_sync.mutex library"
    select PIGWEED_SYNC
    select PIGWEED_POLYFILL
    help
      See :ref:`module-pw_sync` for module details.

config PIGWEED_SYNC_MUTEX_NONE
    bool "Provide your own pw_sync.mutex backend"
    help
      Pigweed's Zephyr backend is not linked in. Wire up your own via
      pw_set_backend() or an equivalent mechanism.

endchoice

choice PIGWEED_SYNC_TIMED_MUTEX_BACKEND
    prompt "pw_sync.timed_mutex backend used"
    default PIGWEED_SYNC_TIMED_MUTEX
    help
      Defaults to Pigweed's Zephyr backend. Choose "none" to provide
      your own with pw_set_backend().

config PIGWEED_SYNC_TIMED_MUTEX
    bool "Link pw_sync.timed_mutex library"
    help
      See :ref:`module-pw_sync` for module details.

config PIGWEED_SYNC_TIMED_MUTEX_NONE
    bool "Provide your own pw_sync.timed_mutex backend"
    help
      Pigweed's Zephyr backend is not linked in. Wire up your own via
      pw_set_backend() or an equivalent mechanism.

endchoice

choice PIGWEED_SYNC_BINARY_SEMAPHORE_BACKEND
    prompt "pw_sync.binary_semaphore backend used"
    default PIGWEED_SYNC_BINARY_SEMAPHORE
    help
      Defaults to Pigweed's Zephyr backend. Choose "none" to provide
      your own with pw_set_backend().

config PIGWEED_SYNC_BINARY_SEMAPHORE
    bool "Link pw_sync.binary_semaphore library"
    select PIGWEED_SYNC
    help
      See :ref:`module-pw_sync` for module details.

config PIGWEED_SYNC_BINARY_SEMAPHORE_NONE
    bool "Provide your own pw_sync.binary_semaphore backend"
    help
      Pigweed's Zephyr backend is not linked in. Wire up your own via
      pw_set_backend() or an equivalent mechanism.

endchoice

choice PIGWEED_SYNC_COUNTING_SEMAPHORE_BACKEND
    prompt "pw_sync.counting_semaphore backend used"
    default PIGWEED_SYNC_COUNTING_SEMAPHORE
    help
      Defaults to Pigweed's Zephyr backend. Choose "none" to provide
      your own with pw_set_backend().

config PIGWEED_SYNC_COUNTING_SEMAPHORE
    bool "Link pw_sync.counting_semaphore library"
    select PIGWEED_SYNC
    help
      See :ref:`module-pw_sync` for module details.

config PIGWEED_SYNC_COUNTING_SEMAPHORE_NONE
    bool "Provide your own pw_sync.counting_semaphore backend"
    help
      Pigweed's Zephyr backend is not linked in. Wire up your own via
      pw_set_backend() or an equivalent mechanism.

endchoice

choice PIGWEED_SYNC_INTERRUPT_SPIN_LOCK_BACKEND
    prompt "pw_sync.interrupt_spin_lock backend used"
    default PIGWEED_SYNC_INTERRUPT_SPIN_LOCK
    help
      Defaults to Pigweed's Zephyr backend. Choose "none" to provide
      your own with pw_set_backend().

config PIGWEED_SYNC_INTERRUPT_SPIN_LOCK
    bool "Link pw_sync.interrupt_spin_lock library"
    help
      See :ref:`module-pw_sync` for module details.

config PIGWEED_SYNC_INTERRUPT_SPIN_LOCK_NONE
    bool "Provide your own pw_sync.interrupt_spin_lock backend"
    help
      Pigweed's Zephyr backend is not linked in. Wire up your own via
      pw_set_backend() or an equivalent mechanism.

endchoice

choice PIGWEED_SYNC_THREAD_NOTIFICATION_BACKEND
    prompt "pw_sync.thread_notification backend used"
    default PIGWEED_SYNC_THREAD_NOTIFICATION
    help
      Defaults to Pigweed's Zephyr backend. Choose "none" to provide
      your own with pw_set_backend().

config PIGWEED_SYNC_THREAD_NOTIFICATION
    bool "Link pw_sync.thread_notification library"
    help
      See :ref:`module-pw_sync` for module details.

config PIGWEED_SYNC_THREAD_NOTIFICATION_NONE
    bool "Provide your own pw_sync.thread_notification backend"
    help
      Pigweed's Zephyr backend is not linked in. Wire up your own via
      pw_set_backend() or an equivalent mechanism.

endchoice

choice PIGWEED_SYNC_TIMED_THREAD_NOTIFICATION_BACKEND
    prompt "pw_sync.timed_thread_notification backend used"
    default PIGWEED_SYNC_TIMED_THREAD_NOTIFICATION
    help
      Defaults to Pigweed's Zephyr backend. Choose "none" to provide
      your own with pw_set_backend().

config PIGWEED_SYNC_TIMED_THREAD_NOTIFICATION
    bool "Link pw_sync.timed_thread_notification library"
    help
      See :ref:`module-pw_sync` for module details.

config PIGWEED_SYNC_TIMED_THREAD_NOTIFICATION_NONE
    bool "Provide your own pw_sync.timed_thread_notification backend"
    help
      Pigweed's Zephyr backend is not linked in. Wire up your own via
      pw_set_backend() or an equivalent mechanism.

endchoice

endmenu
```
